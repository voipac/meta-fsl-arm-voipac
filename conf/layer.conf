## conf/layer.conf
```bitbake
# We have a conf and classes directory, add to BBPATH
BBPATH .= ":${LAYERDIR}"

# We have a packages directory, add to BBFILES
BBFILES += "${LAYERDIR}/recipes-*/*/*.bb \
            ${LAYERDIR}/recipes-*/*/*.bbappend"

BBFILE_COLLECTIONS += "fsl-arm-voipac"
BBFILE_PATTERN_fsl-arm-voipac := "^${LAYERDIR}/"
BBFILE_PRIORITY_fsl-arm-voipac = "4"

LAYERDEPENDS_fsl-arm-voipac = "core fsl-arm"
```

## conf/machine/imx6-openrexmax.conf
```bitbake
#@TYPE: Machine
#@NAME: Fedevel i.MX6 OpenRex Max
#@SOC: i.MX6Q
#@DESCRIPTION: Machine configuration for Fedevel i.MX6 OpenRex Max
#@MAINTAINER: support <support@voipac.com>

require conf/machine/include/imx-base.inc
require conf/machine/include/tune-cortexa9.inc

SOC_FAMILY = "mx6:mx6q"

PREFERRED_PROVIDER_u-boot = "u-boot-voipac"
PREFERRED_PROVIDER_virtual/bootloader_mx6 = "u-boot-voipac"
PREFERRED_PROVIDER_u-boot-voipac ?= "2015.04"
PREFERRED_PROVIDER_virtual/kernel_mx6 = "linux-voipac"
PREFERRED_VERSION_linux-voipac ?= "4.1"

UBOOT_CONFIG ??= "sata spi"
UBOOT_CONFIG[spi] = "mx6openrexmax_config"
UBOOT_CONFIG[sata] = "mx6openrexmaxsata_config"

KERNEL_IMAGETYPE = "zImage"
KERNEL_DEVICETREE = "imx6-openrexbasic.dtb imx6-openrexmax.dtb imx6-openrexmax4g.dtb imx6-openrexultra.dtb"

SERIAL_CONSOLE = "115200 ttymxc0"

IMAGE_FSTYPES = "sdcard.gz tar.xz"

MACHINE_EXTRA_RRECOMMENDS += " \
	linux-firmware-iwlwifi-license linux-firmware-iwlwifi-3160-hmw linux-firmware-iwlwifi-4965-2 \
	linux-firmware-rtl-license linux-firmware-rtl8191se \
"

MACHINE_FEATURES += " pci wifi bluetooth 3g"
MACHINE_FIRMWARE_append_mx6 = " firmware-imx-vpu-imx6q firmware-imx-vpu-imx6d"
```

## conf/machine/imx6-rexbasic.conf
```bitbake
#@TYPE: Machine
#@NAME: Fedevel i.MX6 Rex Basic
#@SOC: i.MX6D
#@DESCRIPTION: Machine configuration for Fedevel i.MX6 Rex Basic
#@MAINTAINER: support <support@voipac.com>

require conf/machine/include/imx-base.inc
require conf/machine/include/tune-cortexa9.inc

SOC_FAMILY = "mx6:mx6dl:mx6q"

PREFERRED_PROVIDER_u-boot_mx6 = "u-boot-voipac"
PREFERRED_PROVIDER_virtual/kernel_mx6 = "linux-voipac"
PREFERRED_VERSION_linux-voipac ?= "3.14"

UBOOT_MACHINE ?= "mx6rexbasic_config"

KERNEL_IMAGETYPE = "zImage"
KERNEL_DEVICETREE = "imx6-rexpro.dtb imx6-rexbasic.dtb"

SERIAL_CONSOLE = "115200 ttymxc0"

MACHINE_EXTRA_RRECOMMENDS += "linux-firmware-iwlwifi-license linux-firmware-iwlwifi-4965-2"

MACHINE_FEATURES += " pci wifi bluetooth"
MACHINE_FIRMWARE_append_mx6 = " firmware-imx-vpu-imx6q firmware-imx-vpu-imx6d"
```

## conf/machine/imx6-rexultra.conf
```bitbake
#@TYPE: Machine
#@NAME: Fedevel i.MX6 Rex Ultra
#@SOC: i.MX6Q
#@DESCRIPTION: Machine configuration for Fedevel i.MX6 Rex Ultra
#@MAINTAINER: support <support@voipac.com>

require conf/machine/include/imx-base.inc
require conf/machine/include/tune-cortexa9.inc

SOC_FAMILY = "mx6:mx6dl:mx6q"

PREFERRED_PROVIDER_u-boot_mx6 = "u-boot-voipac"
PREFERRED_PROVIDER_virtual/kernel_mx6 = "linux-voipac"
PREFERRED_VERSION_linux-voipac ?= "3.14"

UBOOT_MACHINE ?= "mx6rexultra_config"

KERNEL_IMAGETYPE = "zImage"
KERNEL_DEVICETREE = "imx6-rexbasic.dtb imx6-rexpro.dtb imx6-rexultra.dtb"

SERIAL_CONSOLE = "115200 ttymxc0"

MACHINE_EXTRA_RRECOMMENDS += " \
	linux-firmware-iwlwifi-license linux-firmware-iwlwifi-4965-2 \
	linux-firmware-rtl-license linux-firmware-rtl8191se \
"

MACHINE_FEATURES += " pci wifi bluetooth"
MACHINE_FIRMWARE_append_mx6 = " firmware-imx-vpu-imx6q firmware-imx-vpu-imx6d"
```

## conf/machine/imx6-tinyrexbasic.conf
```bitbake
#@TYPE: Machine
#@NAME: Fedevel i.MX6 TinyRex Basic
#@SOC: i.MX6S
#@DESCRIPTION: Machine configuration for Fedevel i.MX6 TinyRex Basic
#@MAINTAINER: support <support@voipac.com>

require conf/machine/include/imx-base.inc
require conf/machine/include/tune-cortexa9.inc

SOC_FAMILY = "mx6:mx6dl"

PREFERRED_PROVIDER_u-boot = "u-boot-voipac"
PREFERRED_PROVIDER_virtual/bootloader_mx6 = "u-boot-voipac"
PREFERRED_PROVIDER_u-boot-voipac ?= "2015.04"
PREFERRED_PROVIDER_virtual/kernel_mx6 = "linux-voipac"
PREFERRED_VERSION_linux-voipac ?= "4.1"

UBOOT_CONFIG ??= "spi sd"
UBOOT_CONFIG[sd] = "mx6tinyrexbasic_config"
UBOOT_CONFIG[spi] = "mx6tinyrexbasicrecovery_config"

KERNEL_IMAGETYPE = "zImage"
KERNEL_DEVICETREE = "imx6-tinyrexlite.dtb imx6-tinyrexbasic.dtb imx6-tinyrexpro.dtb imx6-tinyrexmax.dtb imx6-tinyrexmax4g.dtb imx6-tinyrexultra.dtb"

SERIAL_CONSOLE = "115200 ttymxc0"

IMAGE_FSTYPES = "sdcard.gz tar.xz"

MACHINE_EXTRA_RRECOMMENDS += " \
	linux-firmware-iwlwifi-license linux-firmware-iwlwifi-3160-hmw linux-firmware-iwlwifi-4965-2 \
	linux-firmware-rtl-license linux-firmware-rtl8191se \
"

MACHINE_FEATURES += " pci wifi bluetooth"
MACHINE_FIRMWARE_append_mx6 = " firmware-imx-vpu-imx6q firmware-imx-vpu-imx6d"
```

## conf/machine/imx6-tinyrexmax.conf
```bitbake
#@TYPE: Machine
#@NAME: Fedevel i.MX6 TinyRex Max
#@SOC: i.MX6Q
#@DESCRIPTION: Machine configuration for Fedevel i.MX6 TinyRex Max
#@MAINTAINER: support <support@voipac.com>

require conf/machine/include/imx-base.inc
require conf/machine/include/tune-cortexa9.inc

SOC_FAMILY = "mx6:mx6q"

PREFERRED_PROVIDER_u-boot_mx6 = "u-boot-voipac"
PREFERRED_PROVIDER_u-boot-voipac ?=  "2014.10"
PREFERRED_PROVIDER_virtual/kernel_mx6 = "linux-voipac"
PREFERRED_VERSION_linux-voipac ?= "3.14"

UBOOT_MACHINE ?= "mx6tinyrexmax_config"

KERNEL_IMAGETYPE = "zImage"
KERNEL_DEVICETREE = "imx6-tinyrexlite.dtb imx6-tinyrexbasic.dtb imx6-tinyrexpro.dtb imx6-tinyrexmax.dtb imx6-tinyrexultra.dtb"

SERIAL_CONSOLE = "115200 ttymxc0"

MACHINE_EXTRA_RRECOMMENDS += " \
	linux-firmware-iwlwifi-license linux-firmware-iwlwifi-4965-2 \
	linux-firmware-rtl-license linux-firmware-rtl8191se \
"

MACHINE_FEATURES += " pci wifi bluetooth"
MACHINE_FIRMWARE_append_mx6 = " firmware-imx-vpu-imx6q firmware-imx-vpu-imx6d"
```

## conf/machine/imx6-tinyrexpro.conf
```bitbake
#@TYPE: Machine
#@NAME: Fedevel i.MX6 TinyRex Pro
#@SOC: i.MX6D
#@DESCRIPTION: Machine configuration for Fedevel i.MX6 TinyRex Pro
#@MAINTAINER: support <support@voipac.com>

require conf/machine/include/imx-base.inc
require conf/machine/include/tune-cortexa9.inc

SOC_FAMILY = "mx6:mx6dl:mx6q"

PREFERRED_PROVIDER_u-boot_mx6 = "u-boot-voipac"
PREFERRED_PROVIDER_virtual/kernel_mx6 = "linux-voipac"
PREFERRED_VERSION_linux-voipac ?= "3.14"

UBOOT_MACHINE ?= "mx6tinyrexpro_config"

KERNEL_IMAGETYPE = "zImage"
KERNEL_DEVICETREE = "imx6-tinyrexlite.dtb imx6-tinyrexbasic.dtb imx6-tinyrexpro.dtb imx6-tinyrexmax.dtb imx6-tinyrexultra.dtb"

SERIAL_CONSOLE = "115200 ttymxc0"

MACHINE_EXTRA_RRECOMMENDS += " \
	linux-firmware-iwlwifi-license linux-firmware-iwlwifi-4965-2 \
	linux-firmware-rtl-license linux-firmware-rtl8191se \
"

MACHINE_FEATURES += " pci wifi bluetooth"
MACHINE_FIRMWARE_append_mx6 = " firmware-imx-vpu-imx6q firmware-imx-vpu-imx6d"
```

## conf/machine/imx6-tinyrexultra.conf
```bitbake
#@TYPE: Machine
#@NAME: Fedevel i.MX6 TinyRex Ultra
#@SOC: i.MX6QP
#@DESCRIPTION: Machine configuration for Fedevel i.MX6 TinyRex Ultra
#@MAINTAINER: support <support@voipac.com>

require conf/machine/include/imx-base.inc
require conf/machine/include/tune-cortexa9.inc

SOC_FAMILY = "mx6:mx6q"

PREFERRED_PROVIDER_u-boot = "u-boot-voipac"
PREFERRED_PROVIDER_virtual/bootloader_mx6 = "u-boot-voipac"
PREFERRED_PROVIDER_u-boot-voipac ?= "2015.04"
PREFERRED_PROVIDER_virtual/kernel_mx6 = "linux-voipac"
PREFERRED_VERSION_linux-voipac ?= "4.1"

UBOOT_CONFIG ??= "sata spi sd"
UBOOT_CONFIG[sd] = "mx6tinyrexultra_config"
UBOOT_CONFIG[spi] = "mx6tinyrexultrarecovery_config"
UBOOT_CONFIG[sata] = "mx6tinyrexultrasata_config"

KERNEL_IMAGETYPE = "zImage"
KERNEL_DEVICETREE = "imx6-tinyrexlite.dtb imx6-tinyrexbasic.dtb imx6-tinyrexpro.dtb imx6-tinyrexmax.dtb imx6-tinyrexmax4g.dtb imx6-tinyrexultra.dtb"

SERIAL_CONSOLE = "115200 ttymxc0"

IMAGE_FSTYPES = "sdcard.gz tar.xz"

MACHINE_EXTRA_RRECOMMENDS += " \
	linux-firmware-iwlwifi-license linux-firmware-iwlwifi-3160-hmw linux-firmware-iwlwifi-4965-2 \
	linux-firmware-rtl-license linux-firmware-rtl8191se \
"

MACHINE_FEATURES += " pci wifi bluetooth"
MACHINE_FIRMWARE_append_mx6 = " firmware-imx-vpu-imx6q firmware-imx-vpu-imx6d"
```

## conf/machine/imx6d-tinyrexpro.conf
```bitbake
#@TYPE: Machine
#@NAME: Fedevel i.MX6Q TinyRex
#@SOC: i.MX6Q
#@DESCRIPTION: Machine configuration for Fedevel i.MX6Q TinyRex
#@MAINTAINER: support <support@voipac.com>

require conf/machine/include/imx-base.inc
require conf/machine/include/tune-cortexa9.inc

SOC_FAMILY = "mx6:mx6dl:mx6q"

PREFERRED_PROVIDER_u-boot_mx6 = "u-boot-voipac"
PREFERRED_PROVIDER_virtual/kernel_mx6 = "linux-voipac"
PREFERRED_VERSION_linux-voipac ?= "3.14"

UBOOT_MACHINE ?= "mx6tinyrexpro_config"

KERNEL_IMAGETYPE = "zImage"
KERNEL_DEVICETREE = "imx6s-tinyrexlite.dtb imx6s-tinyrexbasic.dtb imx6d-tinyrexpro.dtb imx6q-tinyrexmax.dtb"

SERIAL_CONSOLE = "115200 ttymxc0"

MACHINE_EXTRA_RRECOMMENDS += "linux-firmware-iwlwifi-license linux-firmware-iwlwifi-4965-2"

MACHINE_FEATURES += " pci wifi bluetooth"
MACHINE_FIRMWARE_append_mx6 = " firmware-imx-vpu-imx6q firmware-imx-vpu-imx6d"
```
